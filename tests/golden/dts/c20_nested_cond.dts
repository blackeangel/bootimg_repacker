/dts-v1/;
/ {
	a = <(1 ? 2 : 3 ? 4 : 5) (0 ? 1 : 0 ? 2 : 3) (1 ? 0 ? 7 : 8 : 9)>;
	b = <(1 < 2 == 1) (3 & 1 == 1) (1 | 2 ^ 3 & 4) (1 + 2 << 3) (16 >> 1 + 1)>;
	c = <('\n') ('\x41') ('\101') ('\'') ('"')>;
};
