/dts-v1/;
/ {
	e = <(1 + 2 * 3) (10 / 3) (10 % 4) (1 << 4) (256 >> 4) (3 > 2) (3 < 2) (3 >= 3) (3 <= 2) (3 == 3) (3 != 3)>;
	f = <(5 & 3) (5 | 3) (5 ^ 3) (1 && 0) (1 || 0) (!5) (~0) (-1) (1 ? 2 : 3) (0 ? 2 : 3 ? 4 : 5)>;
	g = <(-0x80000000) ('a' + 1) 0x10UL 07 0xFFU 10LL 11ULL 12L>;
	h = /bits/ 8 <(-1) (255)>, /bits/ 16 <(-2)>;
	i = <((1 + 2) * (3 + 4)) (1 ? (2 ? 3 : 4) : 5) (2 * -3)>;
	j = <(1 << 63 >> 63) (1 << 64) ((1 << 32) >> 32) (0 - 1 == ~0)>;
};
